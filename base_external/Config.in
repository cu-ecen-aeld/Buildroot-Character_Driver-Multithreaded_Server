## base_external/Config.in
```kconfig
# ------------------------------------------------------------------------------
# File        : Config.in
#
# Description : Registers custom package configuration entries provided
#               by the external Buildroot layer.
#
# Author      : Rajkumar Saravanakumar
# ------------------------------------------------------------------------------

source "$BR2_EXTERNAL_project_base_PATH/package/aesd-assignments/Config.in"

source "$BR2_EXTERNAL_project_base_PATH/package/ldd/Config.in"
```

## base_external/package/aesd-assignments/Config.in
```kconfig
# ------------------------------------------------------------------------------
# File        : Config.in
#
# Description : Buildroot configuration entry for the AESD assignments
#               package containing the socket server, character driver,
#               and associated scripts.
#
# Author      : Rajkumar Saravanakumar
# ------------------------------------------------------------------------------

config BR2_PACKAGE_AESD_ASSIGNMENTS
	bool "aesd-assignments"
	help
	  Builds and installs the AESD socket server application,
	  AESD character driver module, and associated startup
	  and shutdown scripts.
```

## base_external/package/ldd/Config.in
```kconfig
# ------------------------------------------------------------------------------
# File        : Config.in
#
# Description : Buildroot configuration entry for the LDD package.
#               Enables integration of the scull and misc-modules
#               kernel drivers into the target image.
#
# Author      : Rajkumar Saravanakumar
# ------------------------------------------------------------------------------

config BR2_PACKAGE_LDD
	bool "ldd"
	help
	  Builds and installs the LDD3 example kernel drivers,
	  including the scull and misc-modules components,
	  into the target root filesystem.
```
